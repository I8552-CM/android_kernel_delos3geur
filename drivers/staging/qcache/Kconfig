## drivers/staging/qcache/Kconfig
```kconfig
config QCACHE
	tristate "Dynamic compression of clean pagecache pages"
	depends on CLEANCACHE
	select LZO_COMPRESS
	select LZO_DECOMPRESS
	default y
	help
	  Qcache is the backend for fmem
```

## drivers/video/msm/Kconfig.rej
```kconfig
--- len/msm/Kconfig	2014-12-19 10:01:02.000000000 +0000
+++ video/msm/Kconfig	2014-07-26 16:43:46.000000000 +0000
@@ -35,6 +35,10 @@
 	bool "Support for triple frame buffer"
 	default n
 
+config CHECK_SETTING_TABLE
+	bool "Check the LCD initial setting"
+	default n
+
 config FB_MSM_MDP_HW
 	bool
 	default n
@@ -113,6 +117,9 @@
 	bool
 	default n
 
+config FB_MSM_MIPI_DSI_WHITESCREEN
+	bool
+	default n	
 config FB_MSM_LCDC
 	bool
 	default n
@@ -173,6 +180,12 @@
 	bool
 	select FB_MSM_LCDC
 	default n
+	
+config FB_MSM_MIPI_CMD_PANEL_AVOID_MOSAIC
+	bool "MIPI CMD mode panel to avoid mosaic"
+	default n
+	---help---
+	  Support for MIPI CMD mode panel to avoid mosaic	
 
 config FB_MSM_MIPI_DSI_TOSHIBA
 	bool
@@ -202,11 +215,11 @@
 	bool
 	select FB_MSM_MIPI_DSI
 
-config FB_MSM_MIPI_DSI_HX8389B
+config FB_MSM_MIPI_DSI_HX8369B
 	bool
 	select FB_MSM_MIPI_DSI
 
-config FB_MSM_MIPI_DSI_OTM9605A
+config FB_MSM_MIPI_DSI_HX8357
 	bool
 	select FB_MSM_MIPI_DSI
 
@@ -219,10 +232,6 @@
 	bool
 	select FB_MSM_MIPI_DSI
 
-config FB_MSM_MIPI_DSI_NT35590
-	bool
-	select FB_MSM_MIPI_DSI
-
 config FB_MSM_MIPI_DSI_TC358764_DSI2LVDS
 	bool
 	select FB_MSM_MIPI_DSI
@@ -309,6 +318,11 @@
 	select FB_MSM_LCDC_PANEL
 	default n
 
+config FB_MSM_LCDC_ILI9486L
+	bool
+	select FB_MSM_LCDC_PANEL
+	default n
+	
 config FB_MSM_LCDC_WXGA
 	bool
 	select FB_MSM_LCDC_PANEL
@@ -379,14 +393,14 @@
 	select FB_MSM_MIPI_DSI_NT35510
 	default n
 
-config FB_MSM_MIPI_HX8389B_VIDEO_QHD_PT
+config FB_MSM_MIPI_HX8369B_WVGA_PT
 	bool
-	select FB_MSM_MIPI_DSI_HX8389B
+	select FB_MSM_MIPI_DSI_HX8369B
 	default n
 
-config FB_MSM_MIPI_OTM9605A_VIDEO_QHD_PT
+config FB_MSM_MIPI_HX8357_CMD_SMD_HVGA_PT
 	bool
-	select FB_MSM_MIPI_DSI_OTM9605A
+	select FB_MSM_MIPI_DSI_HX8357
 	default n
 
 config FB_MSM_MIPI_NT35516_VIDEO_QHD_PT
@@ -399,15 +413,10 @@
         select FB_MSM_MIPI_DSI_NT35516
         default n
 
-config FB_MSM_MIPI_NT35590_CMD_720P_PT
-        bool
-        select FB_MSM_MIPI_DSI_NT35590
-        default n
-
-config FB_MSM_MIPI_NT35590_VIDEO_720P_PT
-        bool
-        select FB_MSM_MIPI_DSI_NT35590
-        default n
+config FB_MSM_LCDC_ILI9486L_HVGA_PT
+	bool
+	select FB_MSM_LCDC_ILI9486L
+	default n
 
 config FB_MSM_MIPI_CHIMEI_WXGA
 	bool "LVDS Chimei WXGA Panel using Toshiba MIPI DSI-to-LVDS bridge."
@@ -581,14 +590,12 @@
 	select FB_MSM_MIPI_NOVATEK_CMD_QHD_PT
 	select FB_MSM_MIPI_NT35510_VIDEO_WVGA_PT
 	select FB_MSM_MIPI_NT35510_CMD_WVGA_PT
-	select FB_MSM_MIPI_HX8389B_VIDEO_QHD_PT
-	select FB_MSM_MIPI_OTM9605A_VIDEO_QHD_PT
+	select FB_MSM_MIPI_HX8369B_WVGA_PT
+	select FB_MSM_MIPI_HX8357_CMD_SMD_HVGA_PT
 	select FB_MSM_MIPI_ORISE_VIDEO_720P_PT
 	select FB_MSM_MIPI_ORISE_CMD_720P_PT
 	select FB_MSM_MIPI_NT35516_VIDEO_QHD_PT
 	select FB_MSM_MIPI_NT35516_CMD_QHD_PT
-	select FB_MSM_MIPI_NT35590_CMD_720P_PT
-	select FB_MSM_MIPI_NT35590_VIDEO_720P_PT
 	select FB_MSM_MIPI_SIMULATOR_VIDEO
 	select FB_MSM_MIPI_CHIMEI_WXGA
 	select FB_MSM_MIPI_CHIMEI_WUXGA
@@ -627,12 +634,8 @@
 	select FB_MSM_MIPI_NOVATEK_CMD_QHD_PT
 	select FB_MSM_MIPI_NT35510_VIDEO_WVGA_PT
 	select FB_MSM_MIPI_NT35510_CMD_WVGA_PT
-	select FB_MSM_MIPI_HX8389B_VIDEO_QHD_PT
-	select FB_MSM_MIPI_OTM9605A_VIDEO_QHD_PT
 	select FB_MSM_MIPI_NT35516_VIDEO_QHD_PT
 	select FM_MSM_MIPI_NT35516_CMD_QHD_PT
-	select FM_MSM_MIPI_NT35590_CMD_720P_PT
-	select FM_MSM_MIPI_NT35590_VIDEO_720P_PT
 	select FB_MSM_MIPI_SIMULATOR_VIDEO
 	---help---
 	  Support for LCDC + MIPI panel auto detect
@@ -651,8 +654,6 @@
 	select FB_MSM_MIPI_NOVATEK_CMD_QHD_PT
 	select FB_MSM_MIPI_NT35510_VIDEO_WVGA_PT
 	select FB_MSM_MIPI_NT35510_CMD_WVGA_PT
-	select FB_MSM_MIPI_HX8389B_VIDEO_QHD_PT
-	select FB_MSM_MIPI_OTM9605A_VIDEO_QHD_PT
 	select FB_MSM_MIPI_ORISE_VIDEO_720P_PT
 	select FB_MSM_MIPI_ORISE_CMD_720P_PT
 	select FB_MSM_MIPI_SIMULATOR_VIDEO
@@ -747,13 +748,13 @@
 	bool "MIPI NT35510 Command WVGA PT Panel"
 	select FB_MSM_MIPI_NT35510_CMD_WVGA_PT
 
-config FB_MSM_MIPI_HX8389B_VIDEO_QHD_PT_PANEL
-	bool "MIPI HX8389B Video QHD PT Panel"
-	select FB_MSM_MIPI_HX8389B_VIDEO_QHD_PT
-
-config FB_MSM_MIPI_OTM9605A_VIDEO_QHD_PT_PANEL
-	bool "MIPI OTM9605A Video QHD PT Panel"
-	select FB_MSM_MIPI_OTM9605A_VIDEO_QHD_PT
+config FB_MSM_MIPI_HX8369B_WVGA_PT_PANEL
+	bool "MIPI HX8369B Video WVGA PT Panel"
+	select FB_MSM_MIPI_HX8369B_WVGA_PT
+
+config FB_MSM_MIPI_HX8357_CMD_SMD_HVGA_PT_PANEL
+	bool "MIPI HX8357 Command BOE HVGA PT Panel"
+	select FB_MSM_MIPI_HX8357_CMD_SMD_HVGA_PT
 
 config FB_MSM_MIPI_NT35516_VIDEO_QHD_PT_PANEL
         bool "MIPI NT35516 Video qHD PT Panel"
@@ -763,24 +764,6 @@
         bool "MIPI NT35516 Command qHD PT Panel"
         select FB_MSM_MIPI_NT35516_CMD_QHD_PT
 
-config FB_MSM_MIPI_NT35590_CMD_720P_PT_PANEL
-        bool "MIPI NT35590 Command 720p PT Panel"
-        select FB_MSM_MIPI_NT35590_CMD_720P_PT
-	---help---
-	Support for Truly NT35590 panel. This
-	panel supports MIPI DSI interface in
-	Command mode. The panel resolution is
-	720p (720x1280).
-
-config FB_MSM_MIPI_NT35590_VIDEO_720P_PT_PANEL
-        bool "MIPI NT35590 Video 720p PT Panel"
-        select FB_MSM_MIPI_NT35590_VIDEO_720P_PT
-	---help---
-	Support for Truly NT35590 panel. This
-	panel supports MIPI DSI interface in
-	Video mode. The panel resolution is
-	720p (720x1280).
-
 config FB_MSM_MIPI_SIMULATOR_VIDEO_PANEL
 	bool "MIPI Simulator Video Panel"
 	select FB_MSM_MIPI_SIMULATOR_VIDEO
@@ -791,6 +774,10 @@
 	---help---
 	  Support for EBI2 TMD QVGA (240x320) and Epson QCIF (176x220) panel
 
+config FB_MSM_LCDC_ILI9486L_HVGA_PT_PANEL
+	bool "LCDC ILI9486L HVGA PT Panel"
+	select FB_MSM_LCDC_ILI9486L_HVGA_PT
+	
 config FB_MSM_HDMI_AS_PRIMARY
 	depends on FB_MSM_HDMI_COMMON
 	bool "Use HDMI as primary panel"
@@ -995,7 +982,7 @@
 
 choice
 	prompt "Default framebuffer color depth"
-	depends on FB_MSM_MDP40 || FB_MSM_MDP31 || FB_MSM_MDP303
+	depends on FB_MSM_MDP40 || FB_MSM_MDP31 || FB_MSM_MDP303 || FB_MSM_MDP30
 	default FB_MSM_DEFAULT_DEPTH_RGBA8888
 
 config FB_MSM_DEFAULT_DEPTH_RGB565
@@ -1009,6 +996,30 @@
 
 endchoice
 
+config BACKLIGHT_KTD253
+	bool "CONFIG_BACKLIGHT_KTD253"
+	default n
+	help
+	  support for KTD253 backlight IC
+
+config FB_MSM_MIPI_SOLUTION_GPS_NOISE
+	bool "FB_MSM_MIPI_SOLUTION_GPS_NOISE"
+	default n
+	
+config MACH_DELOS_OPEN_CHN
+        depends on ARCH_MSM8625
+        default n
+        bool "MSM8x25 DELOS OPEN CHN"
+        help
+          Support for the Qualcomm DELOS OPEN CHN
+
+config MACH_DELOS_DUOS_CTC
+        depends on ARCH_MSM8625
+        default n
+        bool "MSM8x25 DELOS DUOS CTC"
+        help
+          Support for the Qualcomm DELOS DUOS CTC
+
 config FB_MSM_EBI2_EPSON_S1D_QVGA_PANEL
 	bool "EBI2 Epson QVGA Panel"
 	select FB_MSM_EBI2
@@ -1023,6 +1034,12 @@
 	---help---
 	  Support for EBI2 panel auto detect
 
+config VARIANT_SECOND_BOOTIMAGE	  
+	bool "CONFIG_VARIANT_SECOND_BOOTIMAGE"
+	default n
+	help
+	  support for variant second bootimage
+
 if FB_MSM_MDSS
 	source "drivers/video/msm//mdss/Kconfig"
 endif
```
